## conf/machine/imx6q-openrex.conf
```bitbake
#@TYPE: Machine
#@NAME: FAmodio i.MX6Q Openrex
#@SOC: i.MX6Q
#@DESCRIPTION: Machine configuration for FAmodio i.MX6Q Openrex
#@MAINTAINER: Fabiola Amodio <famodio@camtouch3d.com>

require conf/machine/include/imx6openrex-common.inc

SOC_FAMILY = "mx6:mx6q"

KERNEL_DEVICETREE = "imx6q-openrex.dtb "

UBOOT_CONFIG ??= "sd"
UBOOT_CONFIG[sd] = "mx6qopenrex_config,sdcard"

UBOOT_CONFIG[mfgtool] = "mx6qopenrex_config"
```

## conf/machine/imx6s-openrex.conf
```bitbake
#@TYPE: Machine
#@NAME: FAmodio i.MX6S Openrex
#@SOC: i.MX6Q
#@DESCRIPTION: Machine configuration for FAmodio i.MX6S Openrex
#@MAINTAINER: Fabiola Amodio <famodio@camtouch3d.com>

require conf/machine/include/imx6openrex-common.inc

SOC_FAMILY = "mx6:mx6dl"

KERNEL_DEVICETREE = "imx6s-openrex.dtb "

UBOOT_CONFIG ??= "sd"
UBOOT_CONFIG[sd] = "mx6sopenrex_config,sdcard"

UBOOT_CONFIG[mfgtool] = "mx6sopenrex_config"
```
